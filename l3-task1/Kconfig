## l3-task1/Kconfig
```kconfig
menuconfig LED_SUBSYSTEM
bool "LED Subsystem"
default y

if LED_SUBSYSTEM

choice
    prompt "LED blink sleep time"
    default BLINK_SLEEP_1000MS

config BLINK_SLEEP_250MS
    bool "250ms (fast)"

config BLINK_SLEEP_500MS
    bool "500ms (brisk)"

config BLINK_SLEEP_1000MS
    bool "1s (medium)"

config BLINK_SLEEP_2000MS
    bool "2s (slow)"

endchoice

config BLINK_SLEEP_TIME_MS
    int
    default 250   if BLINK_SLEEP_250MS
    default 500   if BLINK_SLEEP_500MS
    default 1000  if BLINK_SLEEP_1000MS
    default 2000  if BLINK_SLEEP_2000MS

menuconfig LED_ADVANCED
    bool "LED Advanced settings"

if LED_ADVANCED

config LED_BRIGHTNESS
    int "LED brightness (0-100)"
    range 0 100
    default 100

config LED_FADE_DURATION_MS
    int "Fade duration (ms)"
    range 0 5000
    default 500

menu "Expert settings"
    visible if LED_ADVANCED

config LED_DEBUG
    bool "Enable LED debugging"

config LED_CUSTOM_BLINK_PATTERN
    bool "Custom blink pattern"

endmenu # Expert settings

endif # LED_ADVANCED

endif # LED_SUBSYSTEM

source "Kconfig.zephyr"
```

## l4-task1/Kconfig
```kconfig
config APP_HEARTBEAT_PERIOD_MS
    int "Heartbeat LED blink period (ms)"
    range 100 2000
    default 500

source "Kconfig.zephyr"
```

## l5-task1/boards/my_board/board.yml
```yaml
board:
  name: my_board
  full_name: MY-BOARD-NRF5340
  vendor: custom
  socs:
  - name: 'nrf5340'
    variants:
    - name: 'ns'
      cpucluster: 'cpuapp'
```

## l5-task2/boards/our_board/Kconfig.our_board
```kconfig
# Copyright (c) 2022 Zephyr Project members and individual contributors
# SPDX-License-Identifier: Apache-2.0

config BOARD_OUR_BOARD
	select SOC_NRF5340_CPUAPP_QKAA if BOARD_OUR_BOARD_NRF5340_CPUAPP
```

## l5-task2/boards/our_board/board.yml
```yaml
board:
  name: our_board
  full_name: OUR-BOARD-NRF5340
  vendor: custom
  socs:
  - name: nrf5340
    variants:
    - name: ''
      cpucluster: cpuapp
```
