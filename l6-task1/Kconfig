## l6-task1/Kconfig
```kconfig
choice
    prompt "LED blink sleep time"
    default BLINK_SLEEP_1000MS

config BLINK_SLEEP_250MS
    bool "250ms (fast)"

config BLINK_SLEEP_500MS
    bool "500ms (brisk)"

config BLINK_SLEEP_1000MS
    bool "1s (medium)"

config BLINK_SLEEP_2000MS
    bool "2s (slow)"

endchoice

config BLINK_SLEEP_TIME_MS
    int
    default 250   if BLINK_SLEEP_250MS
    default 500   if BLINK_SLEEP_500MS
    default 1000  if BLINK_SLEEP_1000MS
    default 2000  if BLINK_SLEEP_2000MS

source "Kconfig.zephyr"
rsource "drivers/sensor/led_sensor/Kconfig"
```

## l7-task1/dts/bindings/sensor/custom,led-sensor.yaml
```yaml
# SPDX-License-Identifier: Apache-2.0

description: On-board LED exposed as a Zephyr sensor device.
 
compatible: "custom,led-sensor"
 
include: base.yaml
 
properties:
  led-gpios:
    type: phandle-array
    required: true
```
